## fridge/configs/rpi4_fridge_defconfig
```kconfig
BR2_aarch64=y
BR2_cortex_a72=y
BR2_ARM_FPU_FP_ARMV8=y
BR2_OPTIMIZE_3=y
BR2_PRIMARY_SITE="https://fridge-build.s3.amazonaws.com/dl"
BR2_SSP_NONE=y
BR2_RELRO_NONE=y
BR2_FORTIFY_SOURCE_NONE=y
BR2_TOOLCHAIN_EXTERNAL=y
BR2_TOOLCHAIN_EXTERNAL_BOOTLIN=y
BR2_ROOTFS_DEVICE_CREATION_DYNAMIC_EUDEV=y
BR2_ROOTFS_MERGED_USR=y
BR2_TARGET_GENERIC_ROOT_PASSWD="fridge"
BR2_TARGET_GENERIC_HOSTNAME="fridge"
BR2_TARGET_GENERIC_ISSUE=""
# BR2_TARGET_GENERIC_GETTY is not set
# BR2_TARGET_GENERIC_REMOUNT_ROOTFS_RW is not set
BR2_SYSTEM_DHCP="eth0"
BR2_ROOTFS_OVERLAY="$(BR2_EXTERNAL_FRIDGE_PATH)/overlay/"
BR2_ROOTFS_POST_BUILD_SCRIPT="$(BR2_EXTERNAL_FRIDGE_PATH)/boards/rpi4-fridge/post-build.sh"
BR2_LINUX_KERNEL=y
BR2_LINUX_KERNEL_CUSTOM_TARBALL=y
BR2_LINUX_KERNEL_CUSTOM_TARBALL_LOCATION="$(call github,raspberrypi,linux,82550f1980ea6699af8ed66b597d4dce24a1fcc9)/linux-82550f1980ea6699af8ed66b597d4dce24a1fcc9.tar.gz"
BR2_LINUX_KERNEL_USE_CUSTOM_CONFIG=y
BR2_LINUX_KERNEL_CUSTOM_CONFIG_FILE="$(BR2_EXTERNAL_FRIDGE_PATH)/boards/rpi4-fridge/linux-defconfig"
# BR2_LINUX_KERNEL_IMAGE is not set
BR2_LINUX_KERNEL_IMAGEGZ=y
BR2_LINUX_KERNEL_DTS_SUPPORT=y
BR2_LINUX_KERNEL_INTREE_DTS_NAME="broadcom/bcm2711-rpi-4-b"
BR2_LINUX_KERNEL_NEEDS_HOST_OPENSSL=y
BR2_LINUX_KERNEL_PATCH="/$(BR2_EXTERNAL_FRIDGE_PATH)/boards/rpi4-fridge/linux-patch/"
BR2_PACKAGE_BUSYBOX_WATCHDOG=y
BR2_PACKAGE_RPI_FIRMWARE=y
BR2_PACKAGE_RPI_FIRMWARE_VARIANT_PI4_CD=y
BR2_PACKAGE_USBMOUNT=y
BR2_PACKAGE_ZLIB_NG=y
BR2_PACKAGE_CA_CERTIFICATES=y
BR2_PACKAGE_CHRONY=y
BR2_PACKAGE_DOCKER_CLI=y
BR2_PACKAGE_DOCKER_ENGINE=y
BR2_PACKAGE_ETHTOOL=y
# BR2_PACKAGE_ETHTOOL_PRETTY_PRINT is not set
BR2_PACKAGE_IPROUTE2=y
BR2_PACKAGE_OPENSSH=y
BR2_PACKAGE_IRQBALANCE=y
BR2_PACKAGE_WIREGUARD_TOOLS=y
BR2_TARGET_ROOTFS_SQUASHFS=y
BR2_TARGET_ROOTFS_SQUASHFS4_ZSTD=y
# BR2_TARGET_ROOTFS_TAR is not set
```
